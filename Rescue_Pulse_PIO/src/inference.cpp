/* inference.cpp - C++ bridge to TFLite Micro.
 *
 * model_data.cc (generated by quantize_model.py) defines the non-const
 * symbols below with C/C++ external linkage, so they are visible here
 * because both files are compiled as C++ by the ESP-IDF build system. */
#include "inference.h"

#include <cstring>

#include "esp_log.h"
#include "esp_heap_caps.h"

#include "tensorflow/lite/micro/micro_interpreter.h"
#include "tensorflow/lite/micro/micro_mutable_op_resolver.h"
#include "tensorflow/lite/schema/schema_generated.h"

extern const unsigned char  g_model_data[];
extern const unsigned int   g_model_data_len;

static const char *TAG = "tflite";

#define TENSOR_ARENA_SIZE (200 * 1024)   /* ample for the 108 KB model */

static uint8_t              *s_arena        = nullptr;
static tflite::MicroInterpreter *s_interpreter = nullptr;

bool inference_init(void)
{
    /* Prefer PSRAM (8 MB on the S3-PRO board); fall back to internal heap. */
    s_arena = (uint8_t *)heap_caps_malloc(TENSOR_ARENA_SIZE,
                                          MALLOC_CAP_SPIRAM | MALLOC_CAP_8BIT);
    if (s_arena == nullptr) {
        ESP_LOGW(TAG, "PSRAM arena alloc failed; using internal heap");
        s_arena = (uint8_t *)heap_caps_malloc(TENSOR_ARENA_SIZE, MALLOC_CAP_8BIT);
    }
    if (s_arena == nullptr) {
        ESP_LOGE(TAG, "Failed to allocate %d-byte tensor arena", TENSOR_ARENA_SIZE);
        return false;
    }
    ESP_LOGI(TAG, "Arena %u bytes @ %p", TENSOR_ARENA_SIZE, (void *)s_arena);

    /* The model uses: ADD, CONV_2D, EXPAND_DIMS, FULLY_CONNECTED, MAX_POOL_2D,
     * MEAN, MUL, RESHAPE, SOFTMAX (9 ops).  <10> leaves one spare slot. */
    static tflite::MicroMutableOpResolver<10> resolver;
    resolver.AddConv2D();
    resolver.AddMaxPool2D();
    resolver.AddFullyConnected();
    resolver.AddSoftmax();
    resolver.AddReshape();
    resolver.AddMean();
    resolver.AddMul();
    resolver.AddAdd();
    resolver.AddExpandDims();

    const tflite::Model *model = tflite::GetModel(g_model_data);
    if (model->version() != TFLITE_SCHEMA_VERSION) {
        ESP_LOGE(TAG, "Model schema %d != supported %d",
                 model->version(), TFLITE_SCHEMA_VERSION);
        return false;
    }

    s_interpreter = new tflite::MicroInterpreter(model, resolver,
                                                 s_arena, TENSOR_ARENA_SIZE);
    TfLiteStatus alloc_status = s_interpreter->AllocateTensors();
    if (alloc_status != kTfLiteOk) {
        ESP_LOGE(TAG, "AllocateTensors() failed: %d", alloc_status);
        return false;
    }

    const TfLiteTensor *in = s_interpreter->input(0);
    ESP_LOGI(TAG, "Model loaded (%u bytes); input[%d] %s dims, %u bytes",
             g_model_data_len,
             in->dims->size,
             in->type == kTfLiteInt8 ? "int8" : "other", in->bytes);
    return true;
}

bool inference_run(const int8_t *input, int8_t *output)
{
    if (s_interpreter == nullptr) {
        return false;
    }

    TfLiteTensor *in = s_interpreter->input(0);
    if (in->bytes != 832) {
        ESP_LOGE(TAG, "Unexpected input size %u (expected 832)", in->bytes);
        return false;
    }
    std::memcpy(in->data.int8, input, in->bytes);

    TfLiteStatus invoke_status = s_interpreter->Invoke();
    if (invoke_status != kTfLiteOk) {
        ESP_LOGE(TAG, "Invoke failed: %d", invoke_status);
        return false;
    }

    TfLiteTensor *out = s_interpreter->output(0);
    std::memcpy(output, out->data.int8, out->bytes);
    return true;
}
